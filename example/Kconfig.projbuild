## example/Kconfig.projbuild
```kconfig
menu "Example MQTT Settings"

config EXAMPLE_MQTT_HOST
    string "MQTT broker host"
    default "admin.jovisdreams.site"

config EXAMPLE_MQTT_TLS_ENABLE
    bool "Enable MQTT TLS"
    default n

config EXAMPLE_MQTT_PORT
    int "MQTT broker port"
    range 1 65535
    default 8883 if EXAMPLE_MQTT_TLS_ENABLE
    default 1883

config EXAMPLE_MQTT_TLS_CA_CERT_PEM
    string "MQTT TLS CA certificate PEM"
    default ""
    depends on EXAMPLE_MQTT_TLS_ENABLE
    help
        Paste the server CA PEM used by the MQTT TLS broker. The first TLS example path uses server authentication.
        Non-empty CA PEM is required when TLS is enabled.

config EXAMPLE_MQTT_CLIENT_ID
    string "MQTT client ID"
    default "esp-lwlte-mqtt-example"

config EXAMPLE_MQTT_TOKEN
    string "ThingsBoard device access token (used as MQTT username)"
    default "Air780EP"

config EXAMPLE_MQTT_KEEPALIVE_S
    int "MQTT keepalive seconds"
    range 10 1200
    default 120

endmenu

menu "Example TCP Settings"

config EXAMPLE_TCP_HOST
    string "TCP server host"
    default "tcpbin.com"

config EXAMPLE_TCP_PORT
    int "TCP server port"
    range 1 65535
    default 443 if EXAMPLE_TCP_TLS_ENABLE
    default 4242

config EXAMPLE_TCP_TLS_ENABLE
    bool "Enable TCP TLS (SSL socket)"
    default n

config EXAMPLE_TCP_TLS_CA_CERT_PEM
    string "TCP TLS CA certificate PEM"
    default ""
    depends on EXAMPLE_TCP_TLS_ENABLE
    help
        Paste the server CA PEM used by the TCP TLS endpoint. Required when
        EXAMPLE_TCP_TLS_ENABLE=y and auth is server authentication.

config EXAMPLE_TCP_PAYLOAD
    string "TCP payload text"
    default "hello from esp-lwlte tcp"

config EXAMPLE_TCP_PAYLOAD_HEX
    string "TCP payload HEX bytes"
    default "68656c6c6f2066726f6d206573702d6c776c7465207463700a"
    help
        When non-empty, decode this HEX string and send the bytes instead of EXAMPLE_TCP_PAYLOAD.

config EXAMPLE_TCP_OPEN_TIMEOUT_MS
    int "TCP open timeout milliseconds"
    range 1000 180000
    default 75000

config EXAMPLE_TCP_SEND_QUEUE_SIZE
    int "TCP send queue size"
    range 1 16
    default 4

config EXAMPLE_TCP_MAX_TX_LEN
    int "TCP max TX length"
    range 1 1460
    default 1460

config EXAMPLE_TCP_MAX_RX_EVENT_LEN
    int "TCP max RX event length"
    range 1 730
    default 730

endmenu
```

## examples/mqtt_client/main/Kconfig.projbuild
```kconfig
menu "Example MQTT Settings"

config EXAMPLE_MQTT_HOST
    string "MQTT broker host"
    default "admin.jovisdreams.site"

config EXAMPLE_MQTT_PORT
    int "MQTT broker port"
    range 1 65535
    default 1883

config EXAMPLE_MQTT_CLIENT_ID
    string "MQTT client ID"
    default "esp-lwlte-mqtt-example"

config EXAMPLE_MQTT_TOKEN
    string "ThingsBoard device access token (used as MQTT username)"
    default ""

config EXAMPLE_MQTT_KEEPALIVE_S
    int "MQTT keepalive seconds"
    range 10 1200
    default 120

endmenu
```

## examples/mqtt_client/sdkconfig.defaults
```kconfig
CONFIG_ESP_MAIN_TASK_STACK_SIZE=6144
CONFIG_LOG_DEFAULT_LEVEL_INFO=y
CONFIG_EXAMPLE_MQTT_TOKEN="Air780EP"
CONFIG_EXAMPLE_MQTT_HOST="admin.jovisdreams.site"
```

## src/Kconfig
```kconfig
menu "esp-lwlte"

    config LWLTE_AT_ENGINE_LOG_IO
        bool "Print AT Engine UART TX/RX"
        default y
        help
            Print AT Engine UART TX commands and non-empty RX lines via ESP_LOGI.
            Logs are formatted as TX:|<command> and RX:|<line>.

endmenu
```
